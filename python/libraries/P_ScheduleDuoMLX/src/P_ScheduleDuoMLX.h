#pragma once
#ifndef __P_SCHEDULEDUOEXTENSION__
#define __P_SCHEDULEDUOEXTENSION__


#if !defined(AVR) && !defined(ESP32) && !defined(ARDUINO_RASPBERRY_PI_PICO) // Pico hinzugefügt 22.5.2025 gebo
#error Platform is not supported
#error Platform is not supported
#endif

#include <MLLExtension.h>
         
//#define _PeterDebugDuo								// allgemeiner Debug
//#define _PeterDebugDuo_Intern							// interne Meldungen Debug, muss zusätzlich zu _PeterDebugDuo gesetzt werden


#ifdef _PeterDebugDuo 
	#ifdef __FlashStringHelper						// Dank Jürgen (jueff) gibt es jetzt keinen Kompilerfehler mehr mit Streaming. 
		#undef __FlashStringHelper
	#endif
	#include <Streaming.h> 	  // https://github.com/janelia-arduino/Streaming
#endif


/*
P_ScheduleDuoExtension 
V 0.10  14.12.2025	Aufbauend auf P_Schedule 0.21.
V 0.11  06.03.2026	Anpassung my_FirstLedStatus auf P_Schedule 0.21.
                    Debugausgaben.
V 0.12	18.06.2026	Random anpassen wegen Pico 2W. Random darf nicht mit Zufall = 0 aufgerufen werden (Danke Jörn).
V 0.13	18.06.2026	Fehlerbehebung.
				
ToDo:

				
		
*/
#ifdef _PeterDebugDuo
	#define MyProgDuo_MSG "0.13"				// Debugausgabe der Version
#endif
/*
Definition in InitDefs.h:
enum DayState_E : uint8_t	// --> don't change the sequence
    {
    Unknown = 0,
    SunSet  = 1,  	// 12 - 24 Uhr   
    SunRise = 2		// 0 Uhr - 12 Uhr Sonnenaufgang
	}
	
// Results generated by Get_getInputut()
#define INP_OFF            0b00000000
#define INP_ON             0b00000011
#define INP_TURNED_ON      0b00000001
#define INP_TURNED_OFF     0b00000010
#define INP_INIT_OFF       0b00000110
 Es ist NICHT moeglich den Ausgang einer Logic Funktion mehrfach zu verwenden weil dadurch
 Zustaende verloren gehen. Die Eingaenge haben 4 verschiedene Zustaende
   INP_OFF            B00000000
   INP_ON             B00000011
   INP_TURNED_ON      B00000001
   INP_TURNED_OFF     B00000010
                              ^
 Die Logic Funktion setzt nur das Letzte Bit.
 Der vorangegabgegangene Zustand wird im Bit mit der Wertigkeit 2 gespeichert.
 Dieses Bit wird am einde einer Updateschleife gesetzt.
 Wenn mehrere Logic Funktionen in die gleiche Variable schreiben, dann wird der Letzte Zustand
 nicht richtig gesetzt => INP_TURNED_ON / _OFF geht verloren ;-(
*/



// Defines für my_FirstLedStatus
	#define myLedOn 1								// LED-Status ist ein
	#define myLedOff 2								// LED-Status ist aus
	#define myLedUnKnow 0							// LED-Status ist unbekannt


#ifndef inch_t										// 26.11.2025 Jürgen
#define inch_t uint8_t
#endif

class P_ScheduleDuoExtension : public MLLExtension
{
private:
	inch_t dstVar1;									// Übergabeparameter 1.LED					// 26.11.2025 Jürgen
	inch_t dstVarN;									// Übergabeparameter letzte LED				// 26.11.2025 Jürgen
	inch_t enableCh;								// Übergabeparameter SI_1					// 26.11.2025 Jürgen
	uint8_t startA_Std;								// Übergabeparameter Start-Stunde 1
	uint8_t startA_Min;								// Übergabeparameter Start-Minute 1
	uint8_t endA_Std;								// Übergabeparameter Ende-Stunde 1
	uint8_t endA_Min;								// Übergabeparameter Ende-Minute 1
	uint8_t startB_Std;								// Übergabeparameter Start-Stunde 2
	uint8_t startB_Min;								// Übergabeparameter Start-Minute 2
	uint8_t endB_Std;								// Übergabeparameter Ende-Stunde 2
	uint8_t endB_Min;								// Übergabeparameter Ende-Minute 2
	uint8_t zufallA;								// Übergabeparameter Zufall-Ticks 2
	uint8_t zufallB;								// Übergabeparameter Zufall-Ticks 2
	boolean neuStart = true;						// NeuStart Flag V0.20
	
	uint16_t my_startA;								// interner Startwert (Zeit umgerechnet) 1
	uint16_t my_endA;								// interner Endwert (Zeit umgerechnet) 1
	uint16_t my_startB;								// interner Startwert (Zeit umgerechnet) 2
	uint16_t my_endB;								// interner Endwert (Zeit umgerechnet) 2
	
	uint8_t my_FirstLedStatus = myLedOff;   		// interner Status der ersten LED

	uint16_t SwitchValA = 0; 						// Zeit-Tick zum schalten
	uint16_t SwitchValB = 0; 						// Zeit-Tick zum schalten
	uint8_t ToDoCnt = 0;							// Anzahl Elemente zum schalten
	uint8_t ToDoCntSum = 0;	
	uint16_t MyAktTime = 0;							// P_Schedule interner Timer, abgeleitet von Darkness & DayState
	uint16_t z_diff = 0;
	uint16_t neuzufallA = 0;						// Für Debugausgabe 'Zufall-Wert verkürzt'
	uint16_t neuzufallB = 0;
	uint8_t orgzufallA = 0;							// Für Debugausgabe 'Zufall-Wert verkürzt'
	uint8_t orgzufallB = 0;
	inch_t DstVar ;									// 26.11.2025 Jürgen für LongInp 

	public:
	// Constructor
	//-----------------------------------------------------------------------------------------------
  P_ScheduleDuoExtension(inch_t dstVar1, inch_t dstVarN, inch_t enableCh, uint8_t startA_Std, uint8_t startA_Min, uint8_t endA_Std, uint8_t endA_Min, uint8_t zufalltickA, uint8_t startB_Std, uint8_t startB_Min, uint8_t endB_Std, uint8_t endB_Min, uint8_t zufalltickB )  
	//-----------------------------------------------------------------------------------------------
  {
	this->dstVar1 = dstVar1;
    this->dstVarN = dstVarN;
    this->enableCh = enableCh;
    this->startA_Std = startA_Std;
	this->startA_Min = startA_Min;
    this->endA_Std = endA_Std;
    this->endA_Min = endA_Min;
	this->startB_Std = startB_Std;
	this->startB_Min = startB_Min;
    this->endB_Std = endB_Std;
    this->endB_Min = endB_Min;
	this->zufallA = zufalltickA;
	this->zufallB = zufalltickB;
	this->neuzufallA = zufalltickA;					// 28.11.2025
	this->neuzufallB = zufalltickB;	
	this->neuStart = true;							// Neustart ist im Constructor aktiviert. V0.20

	orgzufallA = zufalltickA;						// Damit im Debug der Originalwert angezeigt werden kann, wenn Zufall verkürzt wird.
	orgzufallB = zufalltickB;
	my_startA = Uhr2Tick(startA_Std, startA_Min);	// Startzeit umrechnen Rückgabe 
	my_endA = Uhr2Tick(endA_Std, endA_Min);			// Endzeit umrechnen  Rückgabe 
	my_startB = Uhr2Tick(startB_Std, startB_Min);	// Startzeit umrechnen Rückgabe 
	my_endB = Uhr2Tick(endB_Std, endB_Min);			// Endzeit umrechnen  Rückgabe 

	// Ist der Zufallswert > als die Schaltzeit, so wird als Zufall durch 2.5 geteilt verwendet.
	// Sonst bleibt u.U. die LED dauernd an oder aus.
	if (my_startA < my_endA)
	{
		z_diff = (my_endA - my_startA);
		if (z_diff / 2 <= zufallA)
		{
			zufallA = (z_diff * 2) / 5;
			neuzufallA = zufallA;
		}
		z_diff = ((my_startA + 512) - my_endA);
		if (z_diff / 2 <= zufallA)
		{
			zufallA = (z_diff * 2) / 5;
			neuzufallA = zufallA;
		}	
	} else {
		z_diff = 512 - my_startA;
		z_diff = z_diff + my_endA;
		if (z_diff / 2 <= zufallA)
		{
			zufallA = (z_diff * 2) / 5;
			neuzufallA = zufallA;
		}
	}
	if (my_startB < my_endB)
	{
		z_diff = (my_endB - my_startB);
		if (z_diff / 2 <= zufallB)
		{
			zufallB = (z_diff * 2) / 5;
			neuzufallB = zufallB;
		}
		z_diff = ((my_startB + 512) - my_endB);
		if (z_diff / 2 <= zufallB)
		{
			zufallB = (z_diff * 2) / 5;
			neuzufallB = zufallB;
		}	
	} else {
		z_diff = 512 - my_startB;
		z_diff = z_diff + my_endB;
		if (z_diff / 2 <= zufallB)
		{
			zufallB = (z_diff * 2) / 5;
			neuzufallB = zufallB;
		}
	}
	my_FirstLedStatus = myLedOff;					// Aktueller LED-Status (an/aus) der ersten LED (dstVar1)
  }


	private:

#ifdef _PeterDebugDuo	
	uint8_t Delta_ToDoCnt = 0;						// Unnötige Ausgaben gleicher Tick's unterbinden.
	uint16_t Delta_MyAktTime = 0;					// Unnötige Ausgaben gleicher Tick's unterbinden.
	uint8_t flagMitternacht = 0;					// Mitternacht ausgeben
	uint16_t Minutes ;
	
	//---------------
	void AktUhrzeit()
	//---------------
	// Debug-Ausgabe der aktuellen Zeit (derzeit nicht verwendet!!)
	{
		if (Delta_MyAktTime != MyAktTime)
		{
			Minutes = ((uint32_t)MyAktTime * 24*60) / 512;		// 0.19
			Serial << "P_D- " << "+Uhrzeit: " <<  _WIDTHZ(Minutes/60,2) << ":" <<  _WIDTHZ(Minutes%60,2) << " MyAktTime " << MyAktTime << " Darkness: " << Darkness << " DayState " << DayState << endl;
			Delta_MyAktTime = MyAktTime;
		}
	}
	
	//---------------
	void SchaltzeitInfo(uint8_t xLed, uint8_t xAnAus, uint8_t xZufallA, uint8_t xZufallB, uint8_t xTyp)
	//---------------
	// Debug-Ausgabe der aktuellen SchaltZeit		// 02.12.2025
	{
		uint8_t xZuf = 0;
		char cZuf = 41;
		Minutes = ((uint32_t)MyAktTime * 24*60) / 512;	// 0.19
		if (xAnAus == myLedOn)
		{
			if (xTyp == 1)
			{
			Serial << "P_D- ++Schaltzeit: " <<  _WIDTHZ(Minutes/60,2) << ":" <<  _WIDTHZ(Minutes%60,2) << " Soll Ein: " <<  _WIDTHZ(startA_Std,2) << ":" << _WIDTHZ(startA_Min,2) <<  " Zufall: " << _WIDTH(zufallA,3) <<  " xZufall: " << _WIDTH(xZufallA,3) <<  " - LED: " << _WIDTH(xLed,4) << " Zustand: ein ("  << xAnAus  << ") Zeit " << " A " << endl;
			} else
			{
			Serial << "P_D- ++Schaltzeit: " <<  _WIDTHZ(Minutes/60,2) << ":" <<  _WIDTHZ(Minutes%60,2) << " Soll Ein: " <<  _WIDTHZ(startB_Std,2) << ":" << _WIDTHZ(startB_Min,2) <<  " Zufall: " << _WIDTH(zufallB,3) <<  " xZufall: " << _WIDTH(xZufallB,3) <<  " - LED: " << _WIDTH(xLed,4) << " Zustand: ein ("  << xAnAus  << ") Zeit " << " B " << endl;
			}
		} else {
			if (xTyp == 1)
			{
			Serial << "P_D- --Schaltzeit: " <<  _WIDTHZ(Minutes/60,2) << ":" <<  _WIDTHZ(Minutes%60,2) << " Soll Aus: " <<  _WIDTHZ(endA_Std,2) << ":" << _WIDTHZ(endA_Min,2) <<  " Zufall: " << _WIDTH(zufallA,3) <<  " xZufall: " << _WIDTH(xZufallA,3) <<  " - LED: " << _WIDTH(xLed,4) << " Zustand: aus ("  << xAnAus  << ") Zeit " << " A " << endl;
			} else
			{
			Serial << "P_D- --Schaltzeit: " <<  _WIDTHZ(Minutes/60,2) << ":" <<  _WIDTHZ(Minutes%60,2) << " Soll Aus: " <<  _WIDTHZ(endB_Std,2) << ":" << _WIDTHZ(endB_Min,2) <<  " Zufall: " << _WIDTH(zufallB,3) <<  " xZufall: " << _WIDTH(xZufallB,3) <<  " - LED: " << _WIDTH(xLed,4) << " Zustand: aus ("  << xAnAus  << ") Zeit " << " B " << endl;
			}
		}
	}
#endif

	//--------------------------------------
	void Pausentimer()								// 02.12.2025
	//--------------------------------------
	// Wenn xZufall == 0 ist, wird eine Zwangspause zwischen 2 Schaltungen eingefügt von 100 mSec.
	{
		unsigned long pTime1 = millis();
		unsigned long pTime2 = pTime1 + 100;
		do // Schleife für die Verzögerungszeit
		{  //   
			pTime1 = millis();
		} while (pTime1 < pTime2);
	}
	

	//--------------------------------------
	uint8_t P_RundenMinTakt(uint8_t Minuten)			
	//--------------------------------------
	// Teile Minuten durch 3 und runde.
	// Das Runden der Minuten geschieht aus Speicherplatz-Gründen sehr einfach.
	{
		uint8_t minuteRund = 0;
		minuteRund = Minuten/3;
		if((minuteRund % 3) >= 2) minuteRund++;
		return minuteRund;
 	}
	
	//--------------------------------------------------
	uint16_t Uhr2Tick( uint8_t x_stunde, uint8_t x_minute)
	//--------------------------------------------------
	// Umrechnung der Uhrzeit in MLL-Ticks 
	{
		uint16_t takt = 0;
		takt = x_stunde * 21;
		if (x_stunde > 2) takt ++;
		if (x_stunde > 6) takt ++;
		if (x_stunde > 10) takt ++;
		if (x_stunde > 12) takt ++;
		if (x_stunde > 13) takt ++;
		if (x_stunde > 17) takt ++;
		if (x_stunde > 21) takt ++;
		takt = takt + P_RundenMinTakt(x_minute);
		if (x_minute > 29) takt ++;
		return takt;
	}

	//--------------------------------------
	void CalcSwitchVal( uint8_t LedIs_OnOff)
	//--------------------------------------
	// Schaltzeit durch "Zufall" ermitteln. 
	// Es werden 512 hinzugezählt, um einen negativen Übelauf (Schaltezit - Zufall) zu umgehen.
	// Nach der Rundung werden diese wieder abgezogen. Ist das Ergebnis < 512 ist es der gerechnete neue Schaltwert.
	{
		uint16_t tempSchalt = 0;
		if (LedIs_OnOff == myLedOff)				// LED ist Off  -- Start wird berechnet
		{
			if (zufallA == 0) 						// 0.12 18.06.26
			{
				SwitchValA = 512 + my_startA;
			} else {
				SwitchValA = random(512 + my_startA - zufallA, 512 + my_startA + zufallA);			//	
			}
			if (zufallB == 0)						// 0.12 18.06.26
			{
				SwitchValB = 512 + my_startB;
			} else {
				SwitchValB = random(512 + my_startB - zufallB, 512 + my_startB + zufallB);
			}
		} 
		else 
		{											// LED ist On -- Ende wird berechnet		####
			if (zufallA == 0) 						// 0.12 18.06.26
			{
				SwitchValA = 512 + my_endA;
			} else {
				SwitchValA = random(512 + my_endA - zufallA, 512 + my_endA + zufallA);
			}
			if (zufallB == 0)						// 0.12 18.06.26
			{
				SwitchValB = 512 + my_endB;
			} else {
				SwitchValB = random(512 + my_endB - zufallB, 512 + my_endB + zufallB);
			}
		}
		if (SwitchValA >= 512)						
		{
			SwitchValA = SwitchValA - 512;
			if (SwitchValA >= 512)
			{
				SwitchValA = SwitchValA - 512;
			}
			if (SwitchValA == 0)
			{
				SwitchValA = 1;
			}
		}
		if (SwitchValB >= 512)
		{
			SwitchValB = SwitchValB - 512;
			if (SwitchValB >= 512)
			{
				SwitchValB = SwitchValB - 512;
			}
			if (SwitchValB == 0)
			{
				SwitchValB = 1;
			}
		}
		else
		{
			SwitchValA = SwitchValA;				// Unnötig, nur zur Klarheit.
			SwitchValB = SwitchValB;
		}
		if (neuStart == true) 						// V0.20 Wenn NeuStart aktiv, dann prüfen, ob Einschalt-Zeitpunkt vorher war, aber Ausschaltpunkt noch nicht erreicht.
		{
			if (my_startA < 256) 					// Start vor Mittag (12:00) für 
			{
				if (my_endA > 256) {					// Ende nach Mittag (12:00)
					SwitchValA = MyAktTime + 1;		// Zur Sicherheit 1 MInute zugeben zu aktueller Schaltzeit.
				}	
			}
			if (my_startB < 256) 					// Start vor Mittag (12:00)
			{
				if (my_endB > 256) 					// Ende nach Mittag (12:00)
				{
					SwitchValB = MyAktTime + 1;		// Zur Sicherheit 1 MInute zugeben zu aktueller Schaltzeit.
				}	
			}
			neuStart = false;						// NeuStart-Flag zurücksetzen, da nur einmal benötigt.
		}
	}
	 
	//------------------------------------------
	void Proc_ScheduleMyTime(MobaLedLib_C& mobaLedLib)
	//------------------------------------------
	// Neue MLL-Zeitrechnung aus Darkness & DayState ->  0/511 = Mitternacht, 256 = 12  Uhr Mittag
	// Wird regelmässig über LOOP aufgerufen.
	{
		if (DayState == SunSet)						// 12 - 24 Uhr		Daystate == 2	Darkness 0 - 255 	MyAktTime 257 - 512
		{
			MyAktTime = Darkness + 256;
		} else {									// 0 - 12 Uhr		DayState == 1	Darkness 255 - 0	MyAktTime 0 - 256
			MyAktTime = 256 - Darkness;
		}
//		AktUhrzeit(); 
	}

	//-----------------------------------------------------------------
	uint8_t P_DiffCalc(uint16_t ystart, uint16_t yend, uint8_t yzufall)
	//-----------------------------------------------------------------
	// Prüfe, ob zwischen Start und Ende die Differenz 2x Zufall ist.
	// Falls nicht, so setzte den Zufall auf 1. Ist der ZUfall kleiner als
	// die Zahl der Objekte, so setze Zufall auf 0.
	{
		uint16_t ydiff = 0;
		if (yend > ystart)							// my_start: 8:00 (170) , my_end: 10:00 (213) = 43
		{
			ydiff = yend - ystart;
		} else										// my_start: 10:00 (213), my_end: 8:00 (170) =
		{
			ydiff = ystart - yend;
			ydiff = ydiff *-1;
		}
		if (ydiff <= (yzufall * 2))
		{
			yzufall = 1;
		}
		if (ydiff <= ToDoCntSum)
		{
			yzufall = 0;
		}
		return yzufall;
	}

	//----------------
	uint8_t IfMyTime() 
	//----------------
	// prüft, ob für Schaltzeit A oder B der Schaltpunkt erreicht ist.
	// Wennja wird 1 für Schaltzeit A, 2 für Schaltzeit B zurück gegeben, ansonsten 0.
	{
		uint8_t nErg = 0;
		if (MyAktTime == SwitchValA) 
		{
			nErg = 1;
		}
		if (MyAktTime == SwitchValB)
		{ 
			nErg = 2;
		}
		return nErg;
	}

	//-------------------------------------------------------------------------------------------------------------------------------------------
	void SchalteLEDDuo(MobaLedLib_C& mobaLedLib, uint8_t xArt, inch_t yDstVar1, inch_t yDstVarN, uint8_t yZufallA, uint8_t yZufallB, uint8_t yRandom)
	//-------------------------------------------------------------------------------------------------------------------------------------------
	// xArt 1 = einschalten, 2 = ausschalten
	{
		uint8_t yINP = 0;
		uint8_t yTurned = 0;
		uint8_t yschalt_A_B = 0;
		uint8_t ySet = 0;
		uint8_t ymyLed = 0;
		if (xArt == 1)								// ist Off, soll ein
		{
			yINP = INP_OFF;
			yTurned = INP_TURNED_OFF;
			ySet = 1;
			ymyLed = myLedOn;
		} else 										// ist On, soll Off
		{
			yINP = INP_ON;
			yTurned = INP_TURNED_ON;
			ySet = 0;
			ymyLed = myLedOff;
		}
		for ( DstVar = yDstVar1; DstVar <= yDstVarN; DstVar ++)
		{
			yschalt_A_B = IfMyTime();
			if (yschalt_A_B > 0)
			{
				if (mobaLedLib.Get_Input(DstVar) == yINP || mobaLedLib.Get_Input(DstVar) == yTurned)
				{
					if (yRandom-- == 0)
					{
#ifdef _PeterDebugDuo
						SchaltzeitInfo( DstVar, ymyLed, yZufallA, yZufallB, yschalt_A_B);
#endif		
						mobaLedLib.Set_Input(DstVar,ySet);
						if (yschalt_A_B == 1)
						{
							if (yZufallA == 0)		// 02.12.2025
							{
								Pausentimer();		// 02.12.2025
							}
							ToDoCnt --;
							if (ToDoCnt > 0)
							{
								SwitchValA = SwitchValA + yZufallA;
								if (SwitchValA > 511)
								{
									SwitchValA = yZufallA;
								}
							}
						}
						if (yschalt_A_B == 2)
						{
							if (yZufallB == 0)		// 02.12.2025
							{
								Pausentimer();		// 02.12.2025
							}
							ToDoCnt --;
							if (ToDoCnt > 0)
							{
								SwitchValB = SwitchValB + yZufallB;
								if (SwitchValB > 511)
								{
									SwitchValB = yZufallB;
								}
							}
						}
					} 
				} 
			}
			yschalt_A_B = 0;
		}
	}	




	//------------------------------------------
	void Proc_ScheduleDuo(MobaLedLib_C& mobaLedLib)
	//------------------------------------------
	{
		inch_t DstVar1;
		inch_t DstVarN;
		uint8_t nRandom;
		uint8_t xzufallA = 2;
		uint8_t xzufallB = 2;
		uint16_t xDiff;
		uint8_t schalt_A_B = 0;
		uint8_t getInput;							// = mobaLedLib.Get_Input(enableCh); 		// Input LED-Nummer ????

		DstVar1 = dstVar1;
		DstVarN = dstVarN;
		getInput = mobaLedLib.Get_Input(enableCh); 	// Input #InCh --> bringt 3 zurück
		if (Inp_Is_On(getInput))
		{
			if (ToDoCnt == 0)  
			{
				ToDoCntSum = 0;
				for (DstVar = DstVar1; DstVar <= DstVarN; DstVar ++)	// Zählen der aktiven LED's	// 0.19
				{
						ToDoCnt ++;
						ToDoCntSum ++;				// 02.12.2025
				}
				CalcSwitchVal(my_FirstLedStatus);
			}
			if (ToDoCnt > 0)  						// 02.12.2025
			{
				if (DstVarN - DstVar1 > 0)
				{
					xzufallA = zufallA / ToDoCntSum  ;		// Sind mehrere Objekte vorhanden, so wird der geforderte Zufallswert duch die Anzahl der Objekte. 28.11.2025
					xzufallB = zufallB / ToDoCntSum  ;
					xzufallA = P_DiffCalc(my_startA, my_endA, xzufallA);
					xzufallB = P_DiffCalc(my_startB, my_endB, xzufallB);
				}
				else
				{
					xzufallA = 0;					// Bei nur einem Objekt ist die Berechnung nicht notwendig.
					xzufallB = 0;	
				}
				nRandom = random8(ToDoCnt);
				if (my_FirstLedStatus == myLedOff)	// LED ist noch aus
				{
					SchalteLEDDuo( mobaLedLib, 1, DstVar1, DstVarN, xzufallA, xzufallB, nRandom);
				}
				else    							// LED ist noch ein 	
				{
					SchalteLEDDuo( mobaLedLib, 2, DstVar1, DstVarN, xzufallA, xzufallB, nRandom);
				}
				if (ToDoCnt == 0)
				{
					if (my_FirstLedStatus == myLedOff)
					{
						my_FirstLedStatus = myLedOn ;
					}
					else
					{
						my_FirstLedStatus = myLedOff ;
					}
				}
			} 
		}
	}

 
	public:

	//---------------------------------------------------------------------------------------------------------------------------
	uint8_t BereichPruefung(uint16_t start1, uint16_t ende1, uint16_t start2, uint16_t ende2, uint8_t yZufallA, uint8_t yZufallB) 
	//---------------------------------------------------------------------------------------------------------------------------
	// Prüft, ob sich Zeitbereiche der A_ und B-Zeit überschneiden (einschliesslich des Zufalls). Wenn ja, Ausgabe über serielle Schnittstelle.
	// xReturn ist das Ergebnis der Prüfung:
	// 		0 = alles ok
	//      1 = Start2 liegt im Bereich von Start2/Ende2 (Start vor Ende)
	//      2 = Ende2 liegt im Bereich von Start2/Ende2 (Start vor Ende)
	//     10 = Start2 liegt im Bereich von Start2/Ende2 (Start vor Ende, Start vor Ende, Rechnung bis Mitternacht)
	//     20 = Ende2 liegt im Bereich von Start2/Ende2 (Start vor Ende, Rechnung bis Mitternacht)
	//    100 = Start2 liegt im Bereich von Start2/Ende2 (Start nach Ende, Rechnung ab Mitternacht)
	//    200 = Ende2 liegt im Bereich von Start2/Ende2 (Start vor Ende, Rechnung ab Mitternacht)
	{
		uint8_t xReturn = 0;
	#ifdef _PeterDebugDuo_Intern	
		Serial << "BereichPruefung Inp " << start1 << " - "  << ende1 << " Zufall " << yZufallA << "  -  " << start2  << " - " << ende2 << " Zufall " << yZufallB << endl;  
	#endif
		start1 = 512 + start1 - yZufallA;
		if (start1 > 512)
		{
			start1 = start1 - 512;
		}
		ende1 = 512 + ende1 + yZufallA;
		if (ende1 > 512)
		{
			ende1 = ende1 - 512;
		}
		start2 = 512 + start2 - yZufallB;
		if (start2 > 512)
		{
			start2 = start2 - 512;
		}
		ende2 = 512 + ende2 + yZufallB;
		if (ende2 > 512)
		{
			ende2 = ende2 - 512;
		}
	#ifdef _PeterDebugDuo_Intern	
		Serial << "BereichPruefung Out " << start1 << " - "  << ende1 << "  " << start2  << " - " << ende2 << " (mit Zufall gerechnet)." << endl;  
	#endif	
		if (start1 < ende1)							// Startzeit vor Endzeit
		{
			for (uint16_t i = start1; i <= ende1; i++)
			{
				if (i == start2)
				{
					xReturn = xReturn + 1;				
					break;
				}
				if (i == ende2)
				{
					xReturn =  xReturn + 2;
					break;
				}
			}
		} else										// Startzeit nach Endzeit
		{
			for (uint16_t i = start1; i <= 512; i++)
			{
				if (i == start2)
				{
					xReturn =  xReturn + 10;
					break;
				}
				if (i == ende2)
				{
					xReturn = xReturn + 20;
					break;
				}
			}
			for (uint16_t i = 1; i <= ende1; i++)
			{
				if (i == start2)
				{
					xReturn =  xReturn + 100;
					break;
				}
				if (i == ende2)
				{
					xReturn =  xReturn + 200;
					break;
				}
			}
		}
		return xReturn;								// Ergebnis, siehe oben.
	}

	void FehlerHeader()
	{
		char s[100];
		sprintf(s, "P_ScheduleDuo: Zeit A: %02d:%02d - %02d:%02d, Zeit B: %02d:%02d - %02d:%02d\n", startA_Std, startA_Min, endA_Std, endA_Min, startB_Std, startB_Min, endB_Std, endB_Min);
		Serial.write (s);
	}



	//----------------------------------
	void setup(MobaLedLib_C& mobaLedLib) 
	//----------------------------------
	// Setup der Funktion
	{
	bool bFehlerHeader = false;
    // hier kommt der Code hin, der beim Starten ausgeführt wird
	uint8_t nErg = 0;
	
#ifdef _PeterDebugDuo
	flagMitternacht = 0;
	Serial << "P_D- P_ScheduleDuo Version " << MyProgDuo_MSG <<  endl;
#endif	
	if (neuzufallA != orgzufallA)
	{
		if (bFehlerHeader == false) 
		{
			FehlerHeader();
			bFehlerHeader = true;
		}
		char s[100];
		sprintf(s, "!!! P_ScheduleDuo:  Zufall-Wert A für LED: %d  verkürzt von %d auf %d Ticks\n", int(dstVar1), int(orgzufallA), int(neuzufallA));
		Serial.write(s);
		Serial.flush();
	}
	if (neuzufallB != orgzufallB)
	{
		if (bFehlerHeader == false) 
		{
			FehlerHeader();
			bFehlerHeader = true;
		}
		char s[100];
		sprintf(s, "!!! P_ScheduleDuo:  Zufall-Wert B für LED: %d  verkürzt von %d auf %d Ticks\n", int(dstVar1), int(orgzufallB), int(neuzufallB));
		Serial.write(s);
		Serial.flush();
	}
	nErg = BereichPruefung( my_startA, my_endA, my_startB, my_endB, zufallA, zufallB);
	if ( nErg  > 0)
	{
		if (bFehlerHeader == false) 
		{
			FehlerHeader();
			bFehlerHeader = true;
		}
		char s[100];
		sprintf(s, "!!! P_ScheduleDuo: Zeitbereiche überschneiden sich! (%d)\n", nErg);
		Serial.write(s);
		sprintf(s, "!!! P_ScheduleDuo: Zeit A: %02d:%02d - %02d:%02d  Zufall: +/- %d Ticks \n", (int)startA_Std, (int)startA_Min, (int)endA_Std, (int)endA_Min, (int)zufallA);
		Serial.write(s); 
		sprintf(s, "!!! P_ScheduleDuo: Zeit B: %02d:%02d - %02d:%02d  Zufall: +/- %d Ticks \n", (int)startB_Std, (int)startB_Min, (int)endB_Std, (int)endB_Min, (int)zufallB);
		Serial.write(s);
		Serial.flush();
	}
	if (bFehlerHeader == true)
	{
		Serial.write("---\n");
		Serial.flush();
	}
}


	//----------------------------------
	void loop(MobaLedLib_C& mobaLedLib) 
	//----------------------------------
	// Zyklischer Aufruf der Funktion
	{
    // hier kommt der Code hin, der regelmässig ausgeführt wird
		if (mobaLedLib.Trigger20fps > 0)
		{
			Proc_ScheduleMyTime(mobaLedLib);		// Aktuelle Zeit rechnen für P_Schedule-Zeit
			Proc_ScheduleDuo(mobaLedLib);			// P_Schedule ausführen
		}
#ifdef _PeterDebugDuo
		if (MyAktTime == 1)
		{
			if (flagMitternacht == 0)
			{
				Serial << "Mitternacht!" << endl;
				flagMitternacht = 1;
			}	
		}
		if (MyAktTime > 1)
		{
			flagMitternacht = 0;
		}
#endif	
	}
};
#endif